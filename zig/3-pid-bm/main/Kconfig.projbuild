## zig/3-pid-bm/main/Kconfig.projbuild
```kconfig
menu "WIFI"
    config ESP_WIFI_SSID
        string "WiFi SSID"
        default "$(WIFI_SSID)"
        help
            SSID (network name) for the example to connect to.

    config ESP_WIFI_PASSWORD
        string "WiFi Password"
        default "$(WIFI_PASS)"
        help
            WiFi password (WPA or WPA2) for the example to use.

    config REVOLUTION_THRESHOLD_CLOSE
        string "Revolution treshold close"
        default "$(REVOLUTION_THRESHOLD_CLOSE)"
        help
            ADC reading threshold, below which the magnet is considered to be
            close. Used for calculating the frequency.

    config REVOLUTION_THRESHOLD_FAR
        string "Revolution treshold far"
        default "$(REVOLUTION_THRESHOLD_FAR)"
        help
            ADC reading threshold, above which the magnet is considered to be
            far. Used for calculating the frequency.

    config ESP_MAXIMUM_RETRY
        int "Maximum retry"
        default 5
        help
            Set the Maximum retry to avoid station reconnecting to the AP unlimited when the AP is really inexistent.

    choice ESP_WIFI_SCAN_AUTH_MODE_THRESHOLD
        prompt "WiFi Scan auth mode threshold"
        default ESP_WIFI_AUTH_WPA2_PSK
        help
            The weakest authmode to accept in the scan mode.
            This value defaults to ESP_WIFI_AUTH_WPA2_PSK incase password is present and ESP_WIFI_AUTH_OPEN is used.
            Please select ESP_WIFI_AUTH_WEP/ESP_WIFI_AUTH_WPA_PSK incase AP is operating in WEP/WPA mode.

        config ESP_WIFI_AUTH_OPEN
            bool "OPEN"
        config ESP_WIFI_AUTH_WEP
            bool "WEP"
        config ESP_WIFI_AUTH_WPA_PSK
            bool "WPA PSK"
        config ESP_WIFI_AUTH_WPA2_PSK
            bool "WPA2 PSK"
        config ESP_WIFI_AUTH_WPA_WPA2_PSK
            bool "WPA/WPA2 PSK"
        config ESP_WIFI_AUTH_WPA3_PSK
            bool "WPA3 PSK"
        config ESP_WIFI_AUTH_WPA2_WPA3_PSK
            bool "WPA2/WPA3 PSK"
        config ESP_WIFI_AUTH_WAPI_PSK
            bool "WAPI PSK"
    endchoice

endmenu
```
